/*
*********************************************************************************************************
* 文件 : app_tim.c
* 作者 : zqh			
* 版本 : V1.0
* 日期 : 2026/8/31
* 描述 : 定时器应用层：TIM6定时中断(999Hz，取1.2倍ASM330轴输出速率)提供读取节拍标志/生成模拟数据
* 历史 :
*********************************************************************************************************
*/

#include "main.h"
#include "app_tim.h"
#include "app_spi.h"

volatile uint32_t App_TimUpdateCnt;    // 定时节拍计数(每拍+1)
volatile uint8_t  App_TimTickFlag;     // 定时节拍标志(中断置1，主循环取走后清0)

/*
*********************************************************************************************************
* 函数名 : App_TimUpdateHandle
* 入口参数 : 无
* 返回值 : 无
* 说明 : 定时更新处理：每个节拍计数+1；
*        模拟数据模式下调用App_Asm330SimStep()生成模拟样本(每16拍成一批)
*********************************************************************************************************
*/

void App_TimUpdateHandle(void)
{
    App_TimUpdateCnt++;
    App_TimTickFlag = 1;               // 通知主循环：本节拍到，可以去看一眼有没有新的数据

#if (ASM330_DATA_SRC_SIM != 0)
    App_Asm330SimStep();               // 模拟数据：按节拍生成样本，每16拍提交一批
#endif
}

/*
*********************************************************************************************************
* 函数名 : TIM6_DAC_IRQHandler
* 入口参数 : 无
* 返回值 : 无
* 说明 : TIM6定时器中断服务函数：清除更新中断标志并执行定时更新
*********************************************************************************************************
*/

void TIM6_DAC_IRQHandler(void)
{
    if ((TIM6->SR & TIM_SR_UIF_Msk) != 0U) {
        TIM6->SR = ~TIM_SR_UIF_Msk;    // 清除更新中断标志
        App_TimUpdateHandle();         // 定时更新
    }
}

/*
*********************************************************************************************************
* 函数名 : App_TimInit
* 入口参数 : 无
* 返回值 : 初始化成功返回HAL_OK
* 说明 : TIM6初始化，产生定时节拍中断(默认999Hz，取1.2倍ASM330轴输出速率833Hz)：
*        节拍只负责通知主循环可以去看一眼有没有新数据，本身不读传感器；
*        PSC/ARR由App_TimSetFreq()按80MHz时钟自动计算(支持12.5Hz~6660Hz)
*********************************************************************************************************
*/

HAL_StatusTypeDef App_TimInit(void)
{
    App_TimTickFlag  = 0;                              // 避免定时器一起来就放行一次
    App_TimUpdateCnt = 0;

    __HAL_RCC_TIM6_CLK_ENABLE();

    App_TimSetFreq(TIM_TICK_FREQ_HZ);                  // 装载PSC/ARR：80MHz -> 节拍频率

    TIM6->CR1  = TIM_CR1_URS_Msk;                      // 仅计数器溢出产生更新事件
    TIM6->EGR  = TIM_EGR_UG_Msk;                       // 产生更新事件，立即装载PSC/ARR
    TIM6->SR   = ~TIM_SR_UIF_Msk;                      // 清除更新中断标志
    TIM6->DIER = TIM_DIER_UIE_Msk;                     // 使能更新中断

    HAL_NVIC_SetPriority(TIM6_DAC_IRQn, 1, 0);
    HAL_NVIC_EnableIRQ(TIM6_DAC_IRQn);

    TIM6->CR1 |= TIM_CR1_CEN_Msk;                      // 启动定时器计数

    return HAL_OK;
}

/*
*********************************************************************************************************
* 函数名 : App_TimSetFreq
* 入口参数 : hz - 目标节拍频率(Hz)
* 返回值 : 无
* 说明 : 按80MHz定时器时钟自动选择预分频，保证自动重装值不超过16位：
*        例如999Hz -> PSC=1、ARR=40039(实际998.99Hz)；6660Hz -> PSC=0、ARR=12011
*********************************************************************************************************
*/

void App_TimSetFreq(uint32_t hz)
{
    uint32_t psc, clk, arr;

    if (hz == 0U) {
        return;
    }

    psc = 80000000U / (hz * 65536U);                   // 需要的分频倍数
    clk = 80000000U / (psc + 1U);                      // 计数时钟
    arr = clk / hz;
    if (arr == 0U) {
        arr = 1U;
    }

    TIM6->PSC = psc;
    TIM6->ARR = arr - 1U;
    TIM6->EGR = TIM_EGR_UG_Msk;                        // 立即装载新的PSC/ARR
}
